## boards/nuclei/fpga_eval/Kconfig.nuclei_fpga_eval
```kconfig
# Copyright (c) 2024 Huaqi Fang <hqfang@nucleisys.com>
# SPDX-License-Identifier: Apache-2.0

config BOARD_NUCLEI_FPGA_EVAL
	select SOC_NUCLEI_EVALSOC
```

## boards/nuclei/fpga_eval/board.yml
```yaml
board:
  name: nuclei_fpga_eval
  full_name: Nuclei FPGA Evaluation Board
  vendor: nuclei
  socs:
    - name: nuclei_evalsoc
```

## boards/nuclei/fpga_eval/nuclei_fpga_eval_defconfig
```kconfig
# Nuclei FPGA Evaluation Development Board Configuration
#
# Copyright (c) 2024 Huaqi Fang <hqfang@nucleisys.com>
#
# SPDX-License-Identifier: Apache-2.0


CONFIG_SERIAL=y
CONFIG_UART_INTERRUPT_DRIVEN=y
CONFIG_UART_NUCLEI_PORT_0=y

CONFIG_CONSOLE=y
CONFIG_UART_CONSOLE=y

CONFIG_BUILD_OUTPUT_HEX=y
```

## drivers/serial/Kconfig.nuclei
```kconfig
# Nuclei UART configuration option

# Copyright (c) 2017 Jean-Paul Etienne <fractalclone@gmail.com>
# Modified based Kconfig.sifive
# SPDX-License-Identifier: Apache-2.0

menuconfig UART_NUCLEI
	bool "Nuclei serial driver"
	default y
	depends on DT_HAS_NUCLEI_UART0_ENABLED
	select SERIAL_HAS_DRIVER
	select SERIAL_SUPPORT_INTERRUPT
	help
	  This option enables the Nuclei Freedom serial driver.

# ---------- Port 0 ----------

menuconfig UART_NUCLEI_PORT_0
	bool "NUCLEI Port 0"
	depends on UART_NUCLEI
	help
	  This tells the driver to configure the UART port at boot, depending on
	  the additional configure options below.

config UART_NUCLEI_PORT_0_RXCNT_IRQ
	int "Port 0 RX Interrupt Threshold Count"
	default 0
	depends on UART_NUCLEI_PORT_0
	help
	  Port 0 RX Threshold at which the RX FIFO interrupt triggers.

config UART_NUCLEI_PORT_0_TXCNT_IRQ
	int "Port 0 TX Interrupt Threshold Count"
	default 1
	depends on UART_NUCLEI_PORT_0
	help
	  Port 0 TX Threshold at which the TX FIFO interrupt triggers.

# ---------- Port 1 ----------

menuconfig UART_NUCLEI_PORT_1
	bool "NUCLEI Port 1"
	depends on UART_NUCLEI
	help
	  This tells the driver to configure the UART port at boot, depending on
	  the additional configure options below.

config UART_NUCLEI_PORT_1_RXCNT_IRQ
	int "Port 0 RX Interrupt Threshold Count"
	default 0
	depends on UART_NUCLEI_PORT_1
	help
	  Port 1 RX Threshold at which the RX FIFO interrupt triggers.

config UART_NUCLEI_PORT_1_TXCNT_IRQ
	int "Port 1 TX Interrupt Threshold Count"
	default 1
	depends on UART_NUCLEI_PORT_1
	help
	  Port 1 TX Threshold at which the TX FIFO interrupt triggers.
```

## dts/bindings/serial/nuclei,uart0.yaml
```yaml
# SPDX-License-Identifier: Apache-2.0

description: Nuclei UART

compatible: "nuclei,uart0"

include: [uart-controller.yaml]

properties:
  reg:
    required: true

  interrupts:
    required: true
```

## dts/bindings/sram/nuclei,dlm.yaml
```yaml
# SPDX-License-Identifier: Apache-2.0

description: Nuclei Data Local Memory

compatible: "nuclei,dlm"

include: base.yaml

properties:
  reg:
    required: true
```

## dts/bindings/sram/nuclei,ilm.yaml
```yaml
# SPDX-License-Identifier: Apache-2.0

description: Nuclei Instruction Local Memory

compatible: "nuclei,ilm"

include: base.yaml

properties:
  reg:
    required: true
```

## soc/nuclei/nuclei_evalsoc/Kconfig
```kconfig
# Copyright (c) 2017 Jean-Paul Etienne <fractalclone@gmail.com>
# Copyright (c) 2024 Antmicro <www.antmicro.com>
# SPDX-License-Identifier: Apache-2.0

config SOC_SERIES_NUCLEI_EVALSOC
	bool

	# RISC-V options
	select RISCV
	select RISCV_PRIVILEGED
	select RISCV_HAS_CLIC
	select ATOMIC_OPERATIONS_BUILTIN
	select RISCV_SOC_HAS_GP_RELATIVE_ADDRESSING

	# TODO If you want to use RV64, uncomment the following line
	#select 64BIT
	select CPU_HAS_FPU
	select CPU_HAS_FPU_DOUBLE_PRECISION
	select FPU
	select RISCV_ISA_EXT_M
	select RISCV_ISA_EXT_A
	select RISCV_ISA_EXT_F
	select RISCV_ISA_EXT_D
	select RISCV_ISA_EXT_C
	select RISCV_ISA_EXT_ZICSR
	select RISCV_ISA_EXT_ZIFENCEI

	select INCLUDE_RESET_VECTOR
	select SOC_EARLY_INIT_HOOK
	select SOC_PER_CORE_INIT_HOOK
	select SOC_PREP_HOOK
	imply XIP
```

## soc/nuclei/nuclei_evalsoc/Kconfig.defconfig
```kconfig
# Copyright (c) 2017 Jean-Paul Etienne <fractalclone@gmail.com>
# Copyright (c) 2024 Antmicro <www.antmicro.com>
# SPDX-License-Identifier: Apache-2.0

if SOC_SERIES_NUCLEI_EVALSOC

# TODO: you need to change the default value
# according to your SoC systimer frequency
config SYS_CLOCK_HW_CYCLES_PER_SEC
	default 32768

config RISCV_MCAUSE_EXCEPTION_MASK
	default 0xFFF

config RISCV_SOC_INTERRUPT_INIT
	default y

config RISCV_VECTORED_MODE
	default y if NUCLEI_ECLIC
	default n if !NUCLEI_ECLIC

config GEN_IRQ_VECTOR_TABLE
	default y if NUCLEI_ECLIC
	default n if !NUCLEI_ECLIC

config NUM_IRQS
	default 64 if  NUCLEI_ECLIC
	default 16 if !NUCLEI_ECLIC

# TODO: you need to change the align value
# according to your SoC interrupt number
# see mtvt description in Nuclei ISA Spec
config ARCH_IRQ_VECTOR_TABLE_ALIGN
	default 512 if NUCLEI_ECLIC && !64BIT
	default 1024 if NUCLEI_ECLIC && 64BIT

config RISCV_TRAP_HANDLER_ALIGNMENT
	default 64 if NUCLEI_ECLIC && !RISCV_VECTORED_MODE

endif # SOC_SERIES_NUCLEI_EVALSOC
```

## soc/nuclei/nuclei_evalsoc/Kconfig.soc
```kconfig
# Copyright (c) 2024 Antmicro <www.antmicro.com>
# SPDX-License-Identifier: Apache-2.0

config SOC_SERIES
	default "nuclei_evalsoc" if SOC_SERIES_NUCLEI_EVALSOC

config SOC
	default "nuclei_evalsoc" if SOC_SERIES_NUCLEI_EVALSOC

config SOC_NUCLEI_EVALSOC
	bool
	select SOC_SERIES_NUCLEI_EVALSOC
```
