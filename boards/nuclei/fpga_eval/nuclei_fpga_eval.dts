/*
 * Copyright (c) 2021 Tokita, Hiroshi <tokita.hiroshi@gmail.com>
 *
 * SPDX-License-Identifier: Apache-2.0
 */

/dts-v1/;
#include <nuclei/evalsoc.dtsi>

/*
 * Copyright (c) 2021 Tokita, Hiroshi <tokita.hiroshi@gmail.com>
 *
 * SPDX-License-Identifier: Apache-2.0
 */

#include <zephyr/dt-bindings/input/input-event-codes.h>

/ {
	chosen {
		zephyr,console = &uart0;
		zephyr,shell-uart = &uart0;
		zephyr,sram = &dlm;
		zephyr,flash = &ilm;
	};
};

&uart0 {
	status = "okay";
	current-speed = <115200>;
};

/ {
	model = "Nuclei FPGA Evaluation Board";
	compatible = "nuclei,fpga_eval";
};
